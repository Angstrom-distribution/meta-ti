## conf/machine/usrp-e1xx.conf
```bitbake
#@TYPE: Machine
#@NAME: USRP E1XX machine
#@DESCRIPTION: Machine configuration for the USRP E1XX
TARGET_ARCH = "arm"

PREFERRED_PROVIDER_virtual/xserver = "xserver-xorg"
XSERVER = "xserver-xorg \
           xf86-input-evdev \
           xf86-input-mouse \
           xf86-video-omapfb \
           xf86-input-keyboard"

# Only has DVI connector for external screen
GUI_MACHINE_CLASS = "bigscreen"

require conf/machine/include/omap3.inc

KERNEL_IMAGETYPE = "uImage"

UBOOT_ENTRYPOINT = "0x80008000"
UBOOT_LOADADDRESS = "0x80008000"

EXTRA_IMAGEDEPENDS = ""

PREFERRED_PROVIDER_virtual/kernel = "linux-omap"

IMAGE_FSTYPES = "tar.gz"

# Guesswork
SERIAL_CONSOLE = "115200 ttyS2"

UBOOT_MACHINE = "omap3_overo_config"

# and sdio
MACHINE_FEATURES = "kernel26 screen apm usbgadget usbhost vfat alsa nfs"

module_autoload_usrp_e = "usrp_e"
```
